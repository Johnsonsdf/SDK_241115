## CMakeLists.txt
```
# SPDX-License-Identifier: Apache-2.0

#list(APPEND ZEPHYR_EXTRA_MODULES ${CMAKE_CURRENT_SOURCE_DIR}/../../modules/framework)


cmake_minimum_required(VERSION 3.13.1)

find_package(Zephyr REQUIRED HINTS $ENV{ZEPHYR_BASE})
project(lvgl_demo)

add_subdirectory(src)

if(CONFIG_STACK_CANARIES)
	zephyr_library_compile_options(-DAPP_BT_WATCH -fstack-protector-all)
endif()
```

## Kconfig
```
mainmenu "lvgl demo"

source "Kconfig.zephyr"

menu "App Configuration"

config OTA_UPGRADE
	bool "OTA Upgrade Support"
	default n
	select PARTITION
	select FIRMWARE_VERSION
	select RING_BUFFER
	help
	  This option enable OTA upgrade.

config OTA_BACKEND_BLUETOOTH
    bool "OTA upgrade by Bluetooth Support"
	depends on BT_MANAGER
	select STREAM
    select BT_SPPBLE_STREAM
    default n
    help
      This option enables OTA upgrade by Bluetooth SPP/BLE.

endmenu
```

## prj.conf
```kconfig
#=========== GUI config ===========
CONFIG_UI_MANAGER=n
CONFIG_UI_SERVICE=n
CONFIG_SURFACE_ZERO_BUFFER=y
CONFIG_UI_MEMORY_MANAGER=y
CONFIG_UI_MEMORY_DEBUG=n
CONFIG_MEM_GUARD=n

#actions RES manager
CONFIG_RES_MANAGER=y
CONFIG_RES_MANAGER_USE_STYLE_MMAP=y
CONFIG_RES_MANAGER_SKIP_PRELOAD=n

#actions freetype font
CONFIG_FREETYPE_FONT=y

#actions Bitmap font
CONFIG_BITMAP_FONT=y
CONFIG_BITMAP_FONT_SUPPORT_EMOJI=y
CONFIG_EMOJI_FONT_USE_MMAP=y

#lvgl config
CONFIG_LVGL=y
CONFIG_LVGL_USE_IMG_DECODER_ACTS=y
CONFIG_LVGL_USE_BITMAP_FONT=y
CONFIG_LVGL_USE_FREETYPE_FONT=y
CONFIG_LVGL_USE_RES_MANAGER=y
CONFIG_LVGL_DISPLAY_FLUSH_WORKQ_STACKSIZE=1280
CONFIG_LV_VDB_NUM=2
CONFIG_LV_USE_GPU_ACTS=y
CONFIG_LV_USE_GPU_ACTS_JPG=y
CONFIG_LV_USE_GPU_ACTS_SW_DECODER=y
CONFIG_LV_USE_STRACE=y
CONFIG_LV_COLOR_DEPTH_16=y
# must set 1 to make sure lvgl drawing following vsync
CONFIG_LV_DISP_DEF_REFR_PERIOD=16
CONFIG_LV_INDEV_DEF_READ_PERIOD=16
CONFIG_LV_TXT_ENC_UTF8=y
CONFIG_LV_TXT_BREAK_CHARS=""
CONFIG_LV_FONT_DEFAULT_UNSCII_8=y
CONFIG_LV_CONF_MINIMAL=y
CONFIG_LV_USE_FLEX=y
CONFIG_LV_USE_GRID=y
CONFIG_LV_USE_ARC=y
CONFIG_LV_USE_BTN=y
CONFIG_LV_USE_IMG=y
CONFIG_LV_USE_LABEL=y
CONFIG_LV_USE_SLIDER=y
CONFIG_LV_USE_IMGBTN=y
CONFIG_LV_USE_TILEVIEW=y
CONFIG_LV_USE_QRCODE=y
CONFIG_LV_USE_BARCODE=y
CONFIG_LV_USE_CANVAS=y

#=========== system base config ===========
CONFIG_ACTIONS_FRAMEWORK=y
CONFIG_ACTIONS_FRAMEWORK_DISPLAY=y
CONFIG_THREAD_TIMER=y
CONFIG_ACTIONS_UTILS=y
CONFIG_CORE=y
CONFIG_SYSTEM=y
CONFIG_SYS_CLOCK_TICKS_PER_SEC=1000
CONFIG_PRINTK_TIME_FREFIX=n
CONFIG_SLEEP_SENSOR_RUN_ON_NOR=y
CONFIG_SLEEP_COPY_SRAM_FOR_SENSOR=n
CONFIG_SLEEP_MEMORY_CHECK_INTEGRITY=n
CONFIG_THREAD_RUNTIME_STATS=y
CONFIG_SYSTEM_SHELL=y

#power config
CONFIG_POWER=y

#input config
CONFIG_INPUT=n
CONFIG_INPUT_POINTER=n
CONFIG_INPUT_KEYPAD=n
CONFIG_ACTS_RING_BUFFER=y

#standby config
CONFIG_SYS_STANDBY=y
CONFIG_AUTO_STANDBY_TIME_SEC=10
CONFIG_SYS_WAKELOCK=y

#system message config
CONFIG_NUM_MBOX_ASYNC_MSGS=35
CONFIG_MESSAGE_DEBUG=n

#property config
CONFIG_PROPERTY=y
CONFIG_PROPERTY_CACHE=y

#watchdog config
CONFIG_WATCHDOG=n
CONFIG_WDOG_ACTS=n
CONFIG_WDT_MODE_RESET=n

#dvfs config
CONFIG_DVFS=y
CONFIG_ACTS_DVFS_DYNAMIC_LEVEL=y

#memory config
CONFIG_MEMORY=y
CONFIG_SYS_MEMORY_DEBUG=n
CONFIG_APP_USED_MEM_POOL=y
CONFIG_RAM_POOL_PAGE_NUM=9
CONFIG_HEAP_MEM_POOL_SIZE=2560

#system stack config
CONFIG_MAIN_STACK_SIZE=4096
CONFIG_IDLE_STACK_SIZE=4096
CONFIG_SYSTEM_WORKQUEUE_STACK_SIZE=2048

# sdfs config
CONFIG_SD_FS=y
CONFIG_SDFS_MANAGER=y
CONFIG_MUTIPLE_VOLUME_MANAGER=y
CONFIG_SD_FILE_MAX=24
CONFIG_DISKIO_CACHE=n

#=========== bulooth config ===========
CONFIG_BLUETOOTH=y
CONFIG_ACTS_BT=y
CONFIG_ACTS_BT_SHELL=n
CONFIG_BT_BLE=y
CONFIG_BT_DRV=y
CONFIG_BT_ECC_ACTS=y
CONFIG_BT_HCI_ACTS=y
CONFIG_BT_CTRL_DEBUG=n
CONFIG_BT_CTRL_LOG=y
CONFIG_BT_CTRL_BQB=y
CONFIG_BT_CTRL_RF_DEBUG=n
CONFIG_BT_HCI_TX_PRINT=n
CONFIG_BT_HCI_RX_PRINT=n
CONFIG_HCI_DATA_LOG=y
CONFIG_BT_BREDR=y
CONFIG_BT_CONN_TX_MAX=12
CONFIG_BT_HCI_ACL_FLOW_CONTROL=n
CONFIG_BT_ATT_ENFORCE_FLOW=n
CONFIG_BT_GATT_DYNAMIC_DB=y
CONFIG_BT_MAX_CONN=4
CONFIG_BT_MAX_BR_CONN=2
CONFIG_BT_MAX_PAIRED=4
CONFIG_BT_MAX_BR_PAIRED=2
CONFIG_BT_SPP=y
CONFIG_BT_PBAP_CLIENT=y
CONFIG_BT_MAP_CLIENT=y
CONFIG_BT_HID=y
CONFIG_BT_SDP_CLIENT=y
CONFIG_BT_PERIPHERAL=y
CONFIG_BT_BAS=y
CONFIG_BT_SMP=y
CONFIG_BT_BONDABLE=y
CONFIG_BT_DEVICE_NAME="leopard_bt"
CONFIG_BT_RX_BUF_LEN=680
CONFIG_BT_RX_BUF_COUNT=25
CONFIG_BT_HCI_CMD_COUNT=4
CONFIG_BT_L2CAP_TX_MTU=672
CONFIG_BT_BLE_NOTIFY_PENDING=y
CONFIG_BT_BLE_APP_UPDATE_PARAM=y
CONFIG_BT_ANCS_AMS=y
CONFIG_BT_ACTIONS_SUPER_SERVICE=y

#=========== display config ===========
CONFIG_DISPLAY=y
CONFIG_DISPLAY_LOG_LEVEL_INF=y
CONFIG_DISPLAY_CONTROLLER=y
CONFIG_DISPLAY_ENGINE=y
CONFIG_DISPLAY_ENGINE_INSTANCE_NUM=4
CONFIG_DMA2D_HAL=y
CONFIG_DMA2D_LITE=y
CONFIG_DISPLAY_WORK_Q=y
CONFIG_DISPLAY_WORK_Q_STACK_SIZE=1536

#=========== libc config ===========
CONFIG_NEWLIB_LIBC=y
CONFIG_NEWLIB_LIBC_FLOAT_PRINTF=y
CONFIG_NEWLIB_LIBC_NANO=y

#=========== ota config ===========
CONFIG_OTA=y
CONFIG_OTA_UPGRADE=y
CONFIG_OTA_BACKEND_BLUETOOTH=y

#=========== sensor config ===========
CONFIG_SENSOR_MANAGER=y
CONFIG_SENSOR_ALGO_HR_GH30X=n
CONFIG_SENSOR_ALGO_HR_VCARE=n
CONFIG_SENSOR_ALGO_HR_HX3605=y
CONFIG_SENSOR_ALGO_HR_HX3690=n
CONFIG_SENSOR_ALGO_MOTION_CYWEE=y
CONFIG_SENSOR_ALGO_MOTION_CYWEE_DML=n
CONFIG_SENSOR_ALGO_MOTION_SILAN=n



#=========== used custom linker ===========
CONFIG_HAVE_CUSTOM_LINKER_SCRIPT=y
CONFIG_CUSTOM_LINKER_SCRIPT="linker.ld"
```

## boards/ats3085e_dev_watch_ext_nor.conf
```kconfig
CONFIG_LV_VDB_SIZE=36348
CONFIG_UI_GUI_MEM_POOL_SIZE=391216
CONFIG_UI_RES_MEM_POOL_SIZE=0
#CONFIG_BITMAP_PER_FONT_CACHE_SIZE=16552
CONFIG_BITMAP_FONT_CACHE_POOL_SIZE=0
CONFIG_FREETYPE_FONT_BITMAP_BPP=2
CONFIG_FREETYPE_PER_FONT_CACHE_SIZE=24576
CONFIG_FREETYPE_FONT_ENABLE_MEMORY_FACE=y
CONFIG_FREETYPE_FONT_MAX_FACES=2
CONFIG_FREETYPE_FONT_MAX_SIZES=3
CONFIG_FREETYPE_FONT_SHAPE_CACHE_SIZE=0

CONFIG_SPINAND_ACTS=n
CONFIG_SPINAND_LIB=n

CONFIG_DISK_ACCESS_NOR=y

CONFIG_IPMSG_BTC_FCC_NAME="/NOR:K/fcc.bin"

CONFIG_USER_WORK_Q=y
CONFIG_USER_WORK_Q_PRIORITY=8
```

## src/main.c
```c
/*
 * Copyright (c) 2020 Actions Technology Co., Ltd
 *
 * SPDX-License-Identifier: Apache-2.0
 */

#include <stdio.h>
#include <string.h>
#include <stdint.h>
#include <board_cfg.h>
#include <os_common_api.h>
#include <lvgl.h>
#include <lvgl/porting/lvgl_porting.h>
#include <lvgl/lvgl_bitmap_font.h>
#include <lvgl/lvgl_freetype_font.h>
#include <drivers/input/input_dev.h>
#include <mem_manager.h>
#include <sys_manager.h>
#include <bt_manager.h>
#include <thread_timer.h>
//#include <thread_wdg.h>
#include <sys_wakelock.h>
#include <sensor_manager.h>
#include <partition/partition.h>
#include "app_msg.h"
#include "ota_app.h"

// NOR:A ~ NOR:C --> file_id: 10 ~ 12 (firmware.xml)
#define DEF_FONT22_FILE			"/NOR:C/sans22.font"
#define DEF_VFONT_FILE      	"/NOR:C/vfont.ttf"

static void _disp_vsync_cb(const lv_port_disp_callback_t *callback, uint32_t timestamp);
static void _disp_pm_notify(const struct lv_port_disp_callback *callback, uint32_t pm_state);

static K_SEM_DEFINE(disp_vsync_sem, 0, 1);

static const lv_port_disp_callback_t disp_callback = {
	.vsync = _disp_vsync_cb,
	.pm_notify = _disp_pm_notify,
};

static uint8_t disp_active = 1;

static void _disp_vsync_cb(const lv_port_disp_callback_t *callback, uint32_t timestamp)
{
	k_sem_give(&disp_vsync_sem);
}

static void _disp_pm_notify(const struct lv_port_disp_callback *callback, uint32_t pm_state)
{
	switch (pm_state) {
	case PM_DEVICE_ACTION_EARLY_SUSPEND:
		app_msg_send(APP_NAME, MSG_UI, CMD_SCREEN_OFF);
		break;
	case PM_DEVICE_ACTION_LATE_RESUME:
		app_msg_send(APP_NAME, MSG_UI, CMD_SCREEN_ON);
		break;
	default:
		break;
	}
}

static void _keypad_callback(struct device *dev, struct input_value *val)
{
	static uint32_t last_value = 0;

	SYS_LOG_INF("type: %d, code:%d, value:%d\n", 
		val->keypad.type, val->keypad.code, val->keypad.value);

	if (last_value != val->keypad.value) {
		// screen on
		sys_wake_lock(FULL_WAKE_LOCK);
		sys_wake_unlock(FULL_WAKE_LOCK);

		last_value = val->keypad.value;
	}
}

static void _keypad_init(void)
{
	struct device *onoff_dev;

	onoff_dev = (struct device *)device_get_binding(CONFIG_INPUT_DEV_ACTS_ONOFF_KEY_NAME);
	if (!onoff_dev) {
		SYS_LOG_ERR("cannot found key dev %s", CONFIG_INPUT_DEV_ACTS_ONOFF_KEY_NAME);
		return;
	}

	input_dev_enable(onoff_dev);
	input_dev_register_notify(onoff_dev, _keypad_callback);
}

static void _lvgl_init(void)
{
	lv_port_init();
	lv_port_disp_register_callback(&disp_callback);

	// init font
	lvgl_bitmap_font_init(NULL);
	lvgl_freetype_font_init();
}

static void _anim_callback(void *obj, int32_t val)
{
	lv_obj_set_y(obj, val);
	lv_obj_invalidate(lv_scr_act());
}

static void _lvgl_anim_demo(const char* text)
{
	//static lv_font_t ttf_font;
	//static lv_font_t bmp_font;

	// open ttf font
	//if (lvgl_freetype_font_open(&ttf_font, DEF_VFONT_FILE, 24) < 0) {
		//SYS_LOG_ERR("ttf font not found");
		//return;
	//}

	// open bitmap font
	//if (lvgl_bitmap_font_open(&bmp_font, DEF_FONT22_FILE) < 0) {
		//SYS_LOG_ERR("bitmap font not found");
		//return;
	//}

	lv_obj_t * label = lv_label_create(lv_scr_act());
	lv_obj_set_pos(label, 100, 100);
	lv_obj_set_style_text_color(label, lv_color_make(255, 0, 0), LV_PART_MAIN);
	//lv_obj_set_style_text_font(label, &ttf_font, 0);  // set ttf font
	//lv_obj_set_style_text_font(label, &bmp_font, 0); // set bitmap font
	lv_label_set_text(label, text);

	lv_anim_t anim;
	lv_anim_init(&anim);
	lv_anim_set_var(&anim, label);
	lv_anim_set_values(&anim, 0, CONFIG_PANEL_VER_RES);
	lv_anim_set_time(&anim, 1000);
	lv_anim_set_repeat_count(&anim, LV_ANIM_REPEAT_INFINITE);
	lv_anim_set_playback_time(&anim, 1000);
	lv_anim_set_exec_cb(&anim, _anim_callback);
	lv_anim_start(&anim);

	lv_refr_now(lv_disp_get_default());
}

static int _sensor_callback(int evt_id, sensor_res_t *res)
{
	SYS_LOG_INF("evt_id=%d, handup=%d, step=%d", evt_id, res->handup,
		(uint32_t)res->pedometer.total_steps);

	return 0;
}

static void _sensor_init(void)
{
	sensor_manager_enable(ALGO_ACTIVITY_OUTPUT, 0);
	sensor_manager_enable(ALGO_HANDUP, 0);
	sensor_manager_add_callback(_sensor_callback);
}

static void _process_ui_msg(struct app_msg *msg)
{
	switch (msg->cmd) {
	case CMD_SCREEN_OFF:
		disp_active = 0;
		lv_port_refr_pause();
		break;
	case CMD_SCREEN_ON:
		disp_active = 1;
		lv_port_refr_resume();
		lv_obj_invalidate(lv_scr_act());
		lv_port_refr_ready();
		break;
	default:
		break;
	}
}

int main(void)
{
	// init system
	mem_manager_init();
	system_init();
	bt_manager_init();

	// init app msg
	app_msg_init();

	// init lvgl
	_lvgl_init();

	// ota check and show animation
	if (ota_is_already_running()) {
		SYS_LOG_ERR("Error: ota running!");
	} else if (ota_is_already_done()) {
		_lvgl_anim_demo("Ota done!");
	} else {
		_lvgl_anim_demo("Hello world!");
	}

	// init key device
	_keypad_init();

	// init sensor
	_sensor_init();

	// init ota
	ota_app_init();
	ota_app_init_bluetooth();

	system_ready();

	// start soft watchdog
	//thread_wdg_start();

	while (1) {
		struct app_msg msg;
		uint32_t lv_timeout = lv_task_handler();
		uint32_t tt_timeout = thread_timer_next_timeout();
		uint32_t timeout = MIN(lv_timeout, tt_timeout);

		int rc = poll_msg(&msg, &disp_vsync_sem, timeout);
		switch (rc) {
		case OS_POLL_MSG:
			SYS_LOG_INF("msg type=0x%x, cmd=0x%x", msg.type, msg.cmd);
			switch (msg.type) {
				case MSG_UI:
					_process_ui_msg(&msg);
					break;
				case MSG_OTA:
					ota_app_process();
					break;
			}
			if (msg.callback != NULL) {
				msg.callback(&msg, 0, NULL);
			}
			break;

		case OS_POLL_SEM:
			if (disp_active) {
				lv_port_refr_ready();
			}
			break;
		}

		thread_timer_handle_expired();
	}

	return 0;
}
```

## src/app_msg.c
```c
/*
 * Copyright (c) 2019 Actions Semiconductor Co, Inc.
 *
 * SPDX-License-Identifier: Apache-2.0
 */

#include <os_common_api.h>
#include "app_msg.h"

int app_msg_init(void)
{
	bool ret;
	const char *name = k_thread_name_get(os_current_get());

	ret = msg_manager_add_listener((char*)name, os_current_get());

	return (ret ? 0 : -1);
}

int app_msg_send(const char* receiver, uint8_t type, uint8_t cmd)
{
	bool ret;
	struct app_msg msg;

	memset(&msg, 0, sizeof(msg));
	msg.type = type;
	msg.cmd = cmd;
	ret = send_async_msg((char*)receiver, &msg);

	return (ret ? 0 : -1);
}
```

## src/app_msg.h
```c
/*
 * Copyright (c) 2019 Actions Semiconductor Co., Ltd
 *
 * SPDX-License-Identifier: Apache-2.0
 */

/**
 * @file
 * @brief application message interface
 */

#ifndef __APP_MSG_H__
#define __APP_MSG_H__

#include <msg_manager.h>

// app name
#define APP_NAME	"main"

// app message type
enum APP_MSG_TYPE {
	MSG_UI = MSG_APP_MESSAGE_START,
	MSG_OTA,
};

// app message cmd
enum APP_MSG_CMD {
	CMD_NULL = 0,
	CMD_SCREEN_OFF,
	CMD_SCREEN_ON,
};

int app_msg_init(void);
int app_msg_send(const char* receiver, uint8_t type, uint8_t cmd);

#endif /* __APP_MSG_H__ */
```

## src/ota_app.c
```c
/*
 * Copyright (c) 2019 Actions Semiconductor Co, Inc.
 *
 * SPDX-License-Identifier: Apache-2.0
 */

#include <bt_manager.h>
#include <sys_manager.h>
#include <sys_wakelock.h>
#include <ota_upgrade.h>
#include <ota_backend_bt.h>
#include <drivers/flash.h>
#include <board_cfg.h>
#ifdef CONFIG_PROPERTY
#include <property_manager.h>
#endif
#ifdef CONFIG_DVFS
#include <dvfs.h>
#endif
#include <soc_pstore.h>
#include "ota_app.h"
#include "app_msg.h"

static struct ota_upgrade_info *g_ota;

static void ota_app_start(void)
{
	SYS_LOG_INF("ota app start");

	const struct device *flash_device = device_get_binding(CONFIG_SPI_FLASH_NAME);
	if (flash_device)
		flash_write_protection_set(flash_device, false);

	// send msg to app
	app_msg_send(APP_NAME, MSG_OTA, 0);
}

static void ota_app_stop(void)
{
	SYS_LOG_INF("ota app stop");

	const struct device *flash_device = device_get_binding(CONFIG_SPI_FLASH_NAME);
	if (flash_device)
		flash_write_protection_set(flash_device, true);
}

static void ota_app_backend_callback(struct ota_backend *backend, int cmd, int state)
{
	int err;

	SYS_LOG_INF("backend %p cmd %d state %d", backend, cmd, state);

	if (cmd == OTA_BACKEND_UPGRADE_STATE) {
		if (state == 1) {
			err = ota_upgrade_attach_backend(g_ota, backend);
			if (err) {
				SYS_LOG_INF("unable attach backend");
				return;
			}
			ota_app_start();
		} else {
			ota_upgrade_detach_backend(g_ota, backend);
		}
	} else if (cmd == OTA_BACKEND_UPGRADE_PROGRESS) {
		SYS_LOG_INF("ota progress: %d", state);
	} else if (cmd == OTA_BACKEND_UPGRADE_EXIT) {
		if (bt_manager_ble_is_connected()) {
			bt_manager_ble_disconnect();
		}
	}
}

#ifdef CONFIG_OTA_BACKEND_BLUETOOTH
/* BLE */
/*	"e49a25f8-f69a-11e8-8eb2-f2801f1b9fd1" reverse order  */
#define OTA_SERVICE_UUID BT_UUID_DECLARE_128( \
				0xd1, 0x9f, 0x1b, 0x1f, 0x80, 0xf2, 0xb2, 0x8e, \
				0xe8, 0x11, 0x9a, 0xf6, 0xf8, 0x25, 0x9a, 0xe4)

/* "e49a25e0-f69a-11e8-8eb2-f2801f1b9fd1" reverse order */
#define OTA_CHA_RX_UUID BT_UUID_DECLARE_128( \
				0xd1, 0x9f, 0x1b, 0x1f, 0x80, 0xf2, 0xb2, 0x8e, \
				0xe8, 0x11, 0x9a, 0xf6, 0xe0, 0x25, 0x9a, 0xe4)

/* "e49a28e1-f69a-11e8-8eb2-f2801f1b9fd1" reverse order */
#define OTA_CHA_TX_UUID BT_UUID_DECLARE_128( \
				0xd1, 0x9f, 0x1b, 0x1f, 0x80, 0xf2, 0xb2, 0x8e, \
				0xe8, 0x11, 0x9a, 0xf6, 0xe1, 0x28, 0x9a, 0xe4)

static struct bt_gatt_attr ota_gatt_attr[] = {
	BT_GATT_PRIMARY_SERVICE(OTA_SERVICE_UUID),

	BT_GATT_CHARACTERISTIC(OTA_CHA_RX_UUID, BT_GATT_CHRC_WRITE | BT_GATT_CHRC_WRITE_WITHOUT_RESP,
						BT_GATT_PERM_WRITE, NULL, NULL, NULL),

	BT_GATT_CHARACTERISTIC(OTA_CHA_TX_UUID, BT_GATT_CHRC_NOTIFY,
				BT_GATT_PERM_READ | BT_GATT_PERM_WRITE, NULL, NULL, NULL),

	BT_GATT_CCC(NULL, BT_GATT_PERM_READ | BT_GATT_PERM_WRITE)
};

static const struct ota_backend_bt_init_param bt_init_param = {
	.spp_uuid = NULL,
	.gatt_attr = &ota_gatt_attr[0],
	.attr_size = ARRAY_SIZE(ota_gatt_attr),
	.tx_chrc_attr = &ota_gatt_attr[3],
	.tx_attr = &ota_gatt_attr[4],
	.tx_ccc_attr = &ota_gatt_attr[5],
	.rx_attr = &ota_gatt_attr[2],
	.read_timeout = OS_FOREVER,	/* K_FOREVER, K_NO_WAIT,  K_MSEC(ms) */
	.write_timeout = OS_FOREVER,
};

int ota_app_init_bluetooth(void)
{
	struct ota_backend *backend_bt = ota_backend_bt_init(ota_app_backend_callback,
		(struct ota_backend_bt_init_param *)&bt_init_param);
	if (!backend_bt) {
		SYS_LOG_INF("failed");
		return -ENODEV;
	}

	return 0;
}
#endif

void ota_app_file_cb(uint8_t file_id)
{
	SYS_LOG_INF("ota file_id: %d", file_id);
}

void ota_app_notify(int state, int old_state)
{
	SYS_LOG_INF("ota state: %d->%d", old_state, state);

	if (old_state != OTA_RUNNING && state == OTA_RUNNING) {
	#ifdef CONFIG_DVFS_DYNAMIC_LEVEL
		dvfs_set_level(DVFS_LEVEL_HIGH_PERFORMANCE, "ota");
	#endif
	#ifdef CONFIG_PROPERTY
		property_set("OTA_UPG_FLAG", "run", 5);
		property_flush(NULL);
	#endif
	} else if (old_state == OTA_RUNNING && state != OTA_RUNNING) {
	#ifdef CONFIG_DVFS_DYNAMIC_LEVEL
		dvfs_unset_level(DVFS_LEVEL_HIGH_PERFORMANCE, "ota");
	#endif
	}
	if (state == OTA_DONE) {
	#ifdef CONFIG_PROPERTY
		property_set("REC_OTA_FLAG", "yes", 4);
		property_set("OTA_UPG_FLAG", "done", 5);
		property_flush(NULL);
	#endif
		ota_app_reboot(0);
	}
}

bool ota_is_already_running(void)
{
	char ota_flag[6] = { 0 };

	property_get("OTA_UPG_FLAG", ota_flag, 5);
	if (!memcmp(ota_flag, "run", strlen("run"))) {
		return true;
	}
	return false;
}

bool ota_is_already_done(void)
{
	char ota_flag[6] = { 0 };

	property_get("OTA_UPG_FLAG", ota_flag, 5);
	if (!memcmp(ota_flag, "done", strlen("done"))) {
		return true;
	}
	return false;
}

int ota_app_init(void)
{
	struct ota_upgrade_param param;

	memset(&param, 0x0, sizeof(struct ota_upgrade_param));
	param.storage_name = CONFIG_SPI_FLASH_NAME;
	param.notify = ota_app_notify;
	param.file_cb = ota_app_file_cb;
	param.flag_use_recovery = 1;
	param.flag_erase_part_for_upg = 1;
	param.flag_use_recovery_app = 0;
	param.no_version_control = 1;

	/* keep temp-part on boot, erase temp-part when ota start */
	param.flag_keep_temp_part = 1;

	const struct device *flash_device = device_get_binding(CONFIG_SPI_FLASH_NAME);
	if (flash_device)
		flash_write_protection_set(flash_device, false);

	g_ota = ota_upgrade_init(&param);
	if (!g_ota) {
		SYS_LOG_INF("init failed");
		if (flash_device)
			flash_write_protection_set(flash_device, true);
		return -1;
	}

	if (flash_device)
		flash_write_protection_set(flash_device, true);

#ifdef CONFIG_PROPERTY
	property_set("OTA_UPG_FLAG", "init", 5);
	property_flush(NULL);
#endif

	return 0;
}

int ota_app_process(void)
{
	int ret, prio;

	sys_wake_lock(FULL_WAKE_LOCK);

	prio = os_thread_priority_get(os_current_get());
	os_thread_priority_set(os_current_get(), 6);

	// stop soft watchdog
	//thread_wdg_stop();

	ret = ota_upgrade_check(g_ota);
	if (ret) {
		SYS_LOG_INF("ota_upgrade_check failed");
		ota_app_stop();
	} else {
		SYS_LOG_INF("ota_upgrade_check ok");
	}

	// start soft watchdog
	//thread_wdg_start();

	os_thread_priority_set(os_current_get(), prio);

	sys_wake_unlock(FULL_WAKE_LOCK);

	return ret;
}

int ota_app_reboot(uint8_t temp_file_id)
{
	/*Set temp file_id*/
	if (temp_file_id > 0) {
#ifdef CONFIG_PROPERTY
		property_set("OTA_FILE_ID", (char*)&temp_file_id, sizeof(uint8_t));
		property_flush(NULL);
#endif
	}

	/*Set upgrade state*/
	ota_upgrade_set_in_progress(g_ota);

	/*Set hardware flags to ensure enter ota upgrade durring bootloader*/
	soc_pstore_set(SOC_PSTORE_TAG_OTA_UPGRADE, 1);
	system_power_reboot(REBOOT_REASON_OTA_FINISHED);

	return 0;
}
```

## src/ota_app.h
```c
/*
 * Copyright (c) 2019 Actions Semiconductor Co., Ltd
 *
 * SPDX-License-Identifier: Apache-2.0
 */

/**
 * @file
 * @brief OTA application interface
 */

#ifndef __OTA_APP_H__
#define __OTA_APP_H__

int ota_app_init(void);
int ota_app_init_bluetooth(void);
bool ota_is_already_running(void);
bool ota_is_already_done(void);
int ota_app_process(void);
int ota_app_reboot(uint8_t temp_file_id);

#endif /* __OTA_APP_H__ */
```

## application/bt_watch/boards/ats3085s4_dev_watch_ext_nor.conf
```kconfig
#=========== config for boards ===========
CONFIG_DSP_IMAGE_PATH="/NOR:K/"
CONFIG_APP_STACKSIZE=2048
CONFIG_MAIN_STACK_SIZE=2048

CONFIG_VIEW_SCROLL_MEM_LOWEST=y
CONFIG_VIEW_CACHE_LEVEL=1

CONFIG_LV_VDB_SIZE=217216
CONFIG_UI_MEM_BLOCK_SIZE=434432
CONFIG_UI_MEM_NUMBER_BLOCKS=5
CONFIG_UI_EFFECT_TRANSFORM_BUFFER_COUNT=1
CONFIG_UI_GUI_MEM_POOL_SIZE=49152
CONFIG_UI_RES_MEM_POOL_SIZE=1600000
CONFIG_BITMAP_PER_FONT_CACHE_SIZE=98304
CONFIG_BITMAP_FONT_CACHE_POOL_SIZE=180000
CONFIG_FREETYPE_FONT_BITMAP_BPP=2
CONFIG_FREETYPE_PER_FONT_CACHE_SIZE=40960
CONFIG_FREETYPE_FONT_ENABLE_MEMORY_FACE=y
CONFIG_FREETYPE_FONT_MAX_FACES=2
CONFIG_FREETYPE_FONT_MAX_SIZES=3
#CONFIG_FREETYPE_FONT_ENABLE_SVG_PATH=y
#CONFIG_FREETYPE_SHAPE_INFO_CACHE_SIZE=3072
#CONFIG_FREETYPE_FONT_SHAPE_CACHE_SIZE=120000
CONFIG_OTA_TEMP_PART_DEV_NAME="spi_flash"

#usb mass storage config
CONFIG_MASS_STORAGE_DISK_PDRV=0
CONFIG_MASS_STORAGE_DISK_NAME="NOR"

CONFIG_SPINAND_ACTS=n
CONFIG_SPINAND_LIB=n

CONFIG_DISK_ACCESS_NOR=y
CONFIG_APP_UI_DISK="/NOR:A"
CONFIG_APP_FONT_DISK="/NOR:C"
CONFIG_APP_FAT_DISK="/NOR:"
CONFIG_APP_UI_DISK_B="/NOR:B"
CONFIG_WELCOME_UI_DISK="/NOR:K"

CONFIG_SVG_RENDER=n
CONFIG_MASS_STORAGE_BUF_SIZE=4096

CONFIG_IPMSG_BTC_FCC_NAME="/NOR:K/fcc.bin"
CONFIG_BT_MP_BTC_FILE_NAME="/NOR:K/mp_btc.bin"

CONFIG_USER_WORK_Q=y
CONFIG_USER_WORK_Q_PRIORITY=8

CONFIG_UI_MEM_VDB_SHARE_SURFACE_BUFFER=y

CONFIG_DVFS=y
CONFIG_ACTS_DVFS_DYNAMIC_LEVEL=y

CONFIG_SENSOR_ALGO_MOTION_CYWEE_IN_RAM=n
CONFIG_LCMUSIC_APP=n
CONFIG_BT_TRANSMIT=n
CONFIG_ACTIONS_PARSER=n
CONFIG_CARD_READER_APP=n
CONFIG_USB_DEVICE=n
CONFIG_USB_AOTG_OTG=n
CONFIG_USB_AOTG_DC_ENABLED=n
CONFIG_USB_AOTG_OTG_VERSION=0x551A24CF
CONFIG_USB_DEVICE_DRIVER=n
CONFIG_USB_DEVICE_STACK=n
CONFIG_USB_MASS_STORAGE=n

CONFIG_HAVE_CUSTOM_LINKER_SCRIPT=y
CONFIG_CUSTOM_LINKER_SCRIPT="linker_psram_4m.ld"
```

## application/bt_watch/boards/ats3085s_dev_watch_ext_nor_cat1.conf
```kconfig
#=========== config for boards ===========
CONFIG_DSP_IMAGE_PATH="/NOR:K/"

#CONFIG_VIEW_SCROLL_MEM_LOWEST=y
CONFIG_VIEW_CACHE_LEVEL=2

CONFIG_LV_VDB_SIZE=108578
CONFIG_UI_MEM_BLOCK_SIZE=434432
CONFIG_UI_MEM_NUMBER_BLOCKS=10
CONFIG_UI_GUI_MEM_POOL_SIZE=98304
CONFIG_UI_RES_MEM_POOL_SIZE=2880000
CONFIG_BITMAP_PER_FONT_CACHE_SIZE=98304
CONFIG_BITMAP_FONT_CACHE_POOL_SIZE=180000
CONFIG_FREETYPE_FONT_BITMAP_BPP=2
CONFIG_FREETYPE_PER_FONT_CACHE_SIZE=40960
CONFIG_FREETYPE_FONT_ENABLE_MEMORY_FACE=y
CONFIG_FREETYPE_FONT_MAX_FACES=2
CONFIG_FREETYPE_FONT_MAX_SIZES=3
CONFIG_FREETYPE_SHAPE_INFO_CACHE_SIZE=3072
CONFIG_FREETYPE_FONT_SHAPE_CACHE_SIZE=120000
CONFIG_RES_MANAGER_BLOCK_SIZE=434432
CONFIG_RES_MANAGER_BLOCK_NUM=2

CONFIG_OTA_TEMP_PART_DEV_NAME="spi_flash"

#usb mass storage config
CONFIG_MASS_STORAGE_DISK_PDRV=0
CONFIG_MASS_STORAGE_DISK_NAME="NOR"

CONFIG_SPINAND_ACTS=n
CONFIG_SPINAND_LIB=n

CONFIG_DISK_ACCESS_NOR=y
CONFIG_APP_UI_DISK="/NOR:A"
CONFIG_APP_FONT_DISK="/NOR:C"
CONFIG_APP_FAT_DISK="/NOR:"
CONFIG_APP_UI_DISK_B="/NOR:B"
CONFIG_WELCOME_UI_DISK="/NOR:K"

CONFIG_SVG_RENDER=y

CONFIG_MASS_STORAGE_BUF_SIZE=4096

CONFIG_IPMSG_BTC_FCC_NAME="/NOR:K/fcc.bin"
CONFIG_BT_MP_BTC_FILE_NAME="/NOR:K/mp_btc.bin"

CONFIG_USER_WORK_Q=y
CONFIG_USER_WORK_Q_PRIORITY=8

CONFIG_UI_MEM_VDB_SHARE_SURFACE_BUFFER=y

CONFIG_DVFS=y
CONFIG_ACTS_DVFS_DYNAMIC_LEVEL=y

#=========== video ===========
CONFIG_VIDEO_PLAYER=y
CONFIG_VIDEO_APP=y

#=========== cat1 posix =================
CONFIG_HEAP_MEM_POOL_SIZE=61440
CONFIG_POSIX_MAX_FDS=4
CONFIG_POSIX_API=y
CONFIG_PTHREAD_IPC=y
CONFIG_MAX_PTHREAD_COUNT=100
CONFIG_SEM_VALUE_MAX=32767
CONFIG_MAX_TIMER_COUNT=5
CONFIG_POSIX_MQUEUE=y
CONFIG_MSG_COUNT_MAX=20
CONFIG_MSG_SIZE_MAX=16
CONFIG_MQUEUE_NAMELEN_MAX=32
CONFIG_NEWLIB_LIBC_MIN_REQUIRED_HEAP_SIZE=102400
#============ assert ===============
CONFIG_ASSERT=y
CONFIG_ASSERT_LEVEL=2

#============ CAT1_APP ===============
CONFIG_CAT1_APP=y
```

## framework/display/lvgl/Kconfig
```kconfig
# SPDX-License-Identifier: Apache-2.0

if LVGL

config LVGL_USE_RES_MANAGER
	bool "Enable resource attributes conversion"
	default y
	depends on RES_MANAGER
	help
	  Enable resource atributes conversion

config LVGL_RES_PRELOAD_PRIORITY
	int "Res Preload Thread Prioriy"
	default 5
	depends on LVGL_USE_RES_MANAGER
	help
	This option set res preload thread priority

config LVGL_RES_PRELOAD_STACKSIZE
	int "Res Preload Thread Stack Size"
	default 1536
	depends on LVGL_USE_RES_MANAGER
	help
	This option set stack size for res preload thread

config LVGL_USE_BITMAP_FONT
	bool "Enable bitmap fonts"
	default y
	depends on BITMAP_FONT
	help
	  Enable bitmap font support

config LVGL_USE_FREETYPE_FONT
	bool "Enable freetype fonts"
	default y
	depends on FREETYPE_FONT
	help
	  Enable freetype font support

config LVGL_USE_IMG_DECODER_ACTS
	bool "Enable Actions image decoder"
	help
	  Enable Actions image decoder

config LVGL_USE_IMG_DECODER_ACTS_RES
	bool "Enable Actions image res decoder"
	help
	  Enable Actions image res decoder

config LVGL_DECODE_CACHE_BUF_SIZE
	int "Maximum size of picture decoding(bytes)"
	default 25600
	depends on LVGL_USE_IMG_DECODER_ACTS
	help
	  This option specifies the Maximum size of picture decoding(bytes).

config LVGL_DISPLAY_FLUSH_WORKQ_STACKSIZE
	int "Stack Size of Workq for Display Delayed Flushing"
	default 1024
	depends on UI_SERVICE
	help
	  This option set stack size of workq used for LVGL display delayed flushing.
	  Set 0 to disable delayed flush for small VDB where hardware rendering is
	  fast enough.

endif # LVGL
```

## framework/system/fs_manager/Kconfig
```kconfig
# Kconfig - Actions file system

#
# Copyright (c) 2016 Actions Corporation
#
# SPDX-License-Identifier: Apache-2.0
#

menuconfig MUTIPLE_VOLUME_MANAGER
	bool
	prompt "Mutiple Volume Manager"
	default n
	help
	This option enables actions filesystem


config FS_MANAGER
	bool
	prompt "FS Manager"
	depends on MUTIPLE_VOLUME_MANAGER
	select FILE_SYSTEM
	select FILE_SYSTEM_FAT
	default n
	help
	This option enables actions mutiple volume manager

config SDFS_MANAGER
	bool
	prompt "SDFS Manager"
	depends on MUTIPLE_VOLUME_MANAGER
	select FILE_SYSTEM
	default n
	help
	This option enables actions sdfs manager
```

## thirdparty/lib/gui/lvgl/porting/Kconfig
```kconfig
# SPDX-License-Identifier: Apache-2.0

menuconfig LVGL
	bool "Light and Versatile Graphics Library"
	help
	  This option enables the LVGL GUI library.

if LVGL

config APP_LINK_WITH_LVGL
	bool "Link 'app' with LVGL"
	default y
	help
	  Add LVGL header files to the 'app' include path. It may be
	  disabled if the include paths for LVGL are causing aliasing
	  issues for 'app'.

config LV_Z_USE_FILESYSTEM
	bool "Enable file system"
	depends on FILE_SYSTEM
	default y
	help
	  Enable LVGL file system

config LV_CONF_SKIP
	default n

config LV_MEM_CUSTOM
	default y

config LV_MEMCPY_MEMSET_STD
	default y

config LV_TICK_CUSTOM
	default y

config LV_USE_LOG
	default y

config LV_SPRINTF_CUSTOM
	default y

config LV_ATTRIBUTE_MEM_ALIGN_SIZE
	default 4

config LV_USE_LARGE_COORD
	default y

choice LV_FONT_DEFAULT
	default LV_FONT_DEFAULT_UNSCII_8
endchoice

choice LV_TXT_ENC
	default LV_TXT_ENC_UTF8
endchoice

config LV_USE_THEME_DEFAULT
	default n

config LV_USE_THEME_BASIC
	default n

config LV_USE_THEME_MONO
	default n

config LV_BUILD_EXAMPLES
	default n

rsource "../Kconfig"
rsource "Kconfig.gpu"
rsource "Kconfig.memory"

endif #LVGL
```

## thirdparty/lib/gui/lvgl/porting/Kconfig.gpu
```kconfig
# SPDX-License-Identifier: Apache-2.0

menu "GPU"

config LV_USE_GPU_ACTS
	bool "Use Actions GPU"
	depends on ACTIONS_FRAMEWORK_DISPLAY

if LV_USE_GPU_ACTS

config LV_USE_GPU_ACTS_DMA2D
	bool "Use Actions DMA2D GPU"
	depends on DMA2D_HAL
	default y
	help
	  Must enable DMA2D on Actions platform.

config LV_GPU_ACTS_DMA2D_SIZE_LIMIT
	int "Minimum area (in pixels) for DMA2D processing."
	depends on LV_USE_GPU_ACTS_DMA2D
	default 32

config LV_USE_GPU_ACTS_VG_LITE
	bool "Use Actions VG-Lite GPU"
	depends on VG_LITE
	default y
	help
	  Must enable Verisilicon VG-Lite on Actions platform.

config LV_GPU_ACTS_VG_LITE_SIZE_LIMIT
	int "Minimum area (in pixels) for VG-Lite processing."
	depends on LV_USE_GPU_ACTS_VG_LITE
	default 32

config LV_GPU_ACTS_VG_LITE_COMMAND_BUFFER_SIZE
	int "Command buffer size in kilobytes for VG-Lite processing."
	depends on LV_USE_GPU_ACTS_VG_LITE
	default 32

config LV_USE_GPU_ACTS_JPG
	bool "Use Actions JPG Hardware Decoder"
	depends on JPEG_HAL
	help
	  Must enable JPEG Hardware Decoder Actions platform.

config LV_USE_GPU_ACTS_SW_DECODER
	bool "Use Actions Software Decoder"
	depends on ACTIONS_FRAMEWORK_DISPLAY
	help
	  Must enable Software Decoder Actions platform.

endif # LV_USE_GPU_ACTS

endmenu
```

## thirdparty/lib/gui/lvgl/porting/Kconfig.memory
```kconfig
# SPDX-License-Identifier: Apache-2.0

menu "Memory manager settings"

choice LV_Z_MEMORY_POOL
	prompt "Memory pool"
	default LV_Z_MEM_POOL_SYS_HEAP
	optional
	help
	  Memory pool to use for lvgl allocated objects

	config LV_Z_MEM_POOL_HEAP_LIB_C
		bool "C library Heap"
		depends on !MINIMAL_LIBC || (MINIMAL_LIBC_MALLOC_ARENA_SIZE != 0)
		help
		  Use C library malloc and free to allocate objects on the C library heap

	config LV_Z_MEM_POOL_SYS_HEAP
		bool "User space lvgl pool"
		help
		  Use a dedicated memory pool from a private sys heap.

endchoice

config LV_Z_MEM_POOL_SIZE
	int "Memory pool size"
	default 2048
	depends on LV_Z_MEM_POOL_SYS_HEAP
	help
	  Size of the memory pool in bytes

config LV_VDB_SIZE
	int "Rendering buffer size in pixels"
	default 1
	help
	  Size of the buffer used for rendering screen content in pixels.

config LV_VDB_NUM
	int "Number of VDB for rendering"
	range 1 4
	default 2
	help
	  Number of buffers to render and flush data in parallel.
	  To increase the upper limit, modify LV_DISP_BUF_MAX_NUM in lv_hal_disp.h.

endmenu
```
